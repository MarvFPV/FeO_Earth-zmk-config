## boards/arm/FeO_Earth/Kconfig.board
```kconfig
# BeekQAZ rev1 board configuration

# Copyright (c) 2020 The ZMK Contributors
# SPDX-License-Identifier: MIT

config BOARD_FEO_EARTH
	bool "FeO_Earth Keyboard"
	depends on SOC_NRF52840_QIAA
```

## boards/arm/FeO_Earth/Kconfig.defconfig
```kconfig
# FEO_Earth_rev1 board configuration

# Copyright (c) 2020 The ZMK Contributors
# SPDX-License-Identifier: MIT

if BOARD_FEO_EARTH

config ZMK_KEYBOARD_NAME
	default "FeO_Earth"

if USB

config USB_NRFX
	default y

config USB_DEVICE_STACK
	default y

endif # USB

config BT_CTLR
	default BT

config ZMK_BLE
	default y

config ZMK_USB
	default y

config ZMK_BATTERY_VOLTAGE_DIVIDER
	default y

endif # BOARD_FEO_EARTH
```

## config/west.yml
```yaml
manifest:
  remotes:
    - name: zmkfirmware
      url-base: https://github.com/MarvFPV
  projects:
    - name: zmk
      remote: zmkfirmware
      revision: bt_dis
      import: app/west.yml
  self:
    path: config
```
